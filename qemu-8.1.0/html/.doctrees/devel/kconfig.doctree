## qemu-8.1.0/hw/lc3/Kconfig
```kconfig
config LC3_MCU
    bool

# board name is not same as the arch name: meson.build minikconf
# scripts/minikconf.py
#   if key not in external_vars and config[key]:
#        print ('CONFIG_%s=y' % key)
#
# CONFIG_LC3 is external_vars, produced by meson.build, configs/devices/lc3-softmmu/default.mak CONFIG_LC3 is board name;
#     in external_vars, so no will print to config file; board's source file will not compile

config LC3_BOARD 
    bool
    select LC3_MCU
```
